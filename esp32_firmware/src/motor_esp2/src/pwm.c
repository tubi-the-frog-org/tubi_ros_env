/*
okay let's see if we can understand the using the api espressif provides via
their website recall that the esp chip itself is the ESP32-D0WD-V3 and on the
DOIT ESP32 DEVKIT V1 board


    *   *   *   *   *   *   *   *   *   *   *   *   *   *   *   *   *   *   * *
*   *   * Motor Control Pulse Width Modulator(MCPWM)
    *   *   *   *   *   *   *   *   *   *   *   *   *   *   *   *   *   *   * *
*   *   * The MCPWM peripheral is a versatile PWM generator, which contains
various submodules to make it a key element in power electronic applications
like motor control, digital power, and so on... iT CAN provide six PWM outputs
that can be set up to operate in several topologies. One common topology uses a
pair of PWM outputs driving a H-bridge to control motor rotation speed and
rotation direction. The timing and control resources inside are allocated into
two major types of submodules -PWM Timers and PWM Operators Each PWM timer
provides timing references that can either run freely or be synced to other
timers or external sources. Each PWM operator has all necessary control
resources to generate waveform pairs for one PWM channel. The MCPWM peripheral
also contains a dedicated capture submodule that is used in systems where
accurate timing of external events is important ESP32 contains two MCPWM
peripherals: MCPWM0 & MCPWM1. Their control registers are located in 4kB memory
blocks starting at memory locations 0x3FF5E000 and 0x3FF6C000 respectively

[Overview]
    --PWM Timers 0,1 and 2
    --Every PWM timer has a dedicated 8-bit clock prescaler
    --The 16-bit counter in the PWM timer can work in count-up mode, count-down
mode or count-up-down mode
    --A hardware sync can trigger a reload on the PWM timer with a phase
register. It will also trigger the prescaler's restart, so that the timer's
clock can also be synced. The source of the sync can come from any GPIO or any
    other PWM timer's sync_out

    --PWM Operators 0, 1 and 2
    --Every PWM operator has two PWM outputs: PWMxA and PWMxB. They can work
independently, in symmetric and asymmetric configuration
    --Software, asychronous override control of PWM signals
    --Configurable dead-time on rising and falling edges; each setup
independetly
    --All events can trigger CPU interrupts
    --Modulating of PWM output by high-frequency carrier signals, useful when
gate drives are insulated with a transformer.
    --Period, time stamps and important control register have shadow registers
with flexible updating methods


    --Fault Detection Module
    --Programmable fault handling allocated on fault condition in both
cycle-by-cycle mode and one-shot mode
    --A fault condition can force the PWM output to either high or low logic
levels

    --Capture module
    --Speed measurement of rotating machinery
    --Measurement of elapsed time between position sensor pulses
    --Period and duty-cycle measurement of pulse train signals
    --Decoding current or voltage amplitude derived from duty-cycle encoded
signals from current/voltage sensors
    --Three individual capture channels, each of which has a time-stamp register
32 bits
    --Selection of edge polarity and prescaling of input capture signal
    --The capture timer can sync with a PWM timer or external signals
    --Interrupt on each of the three capture channels



[Features]
Each MCPWM peripheral has one clock divider(prescaler), three PWM timers, three
PWM operators, and a capture module. PWM timers are used for generating timing
references to produce related PWM signals. PWM operators can also use different
PWM timer values to produce the PWM signals that work alone. Different PWM
operators can also use different PWM timer values to produce the PWM signals
that work alone. Different PWM timers can also be synced together.


Typically, the MCPWM peripheral can be used in the following scenarios...
    ---Digital motor control, e.g brushed/brushless DC motor, RC servo motor
    ---Switch mode-based digital power conversion
    ---Power DAC, where the duty cycle is eq. to a DAC analog value
    ---Calculate external pulse width, and convert it into other analog values
like speed, distance
    ---Generate Space Vector PWM (SVPWM) signals for Field Oriented Control
(FOC)

The main submodules being the
    --1.MCPWM SYnc{module focused on synchronizing the MCPWM timers, so that the
final PWM signals generated by different MCPWM generators can have a fixed phase
difference}  : Sync GPIO---Timer Sync goes into.....MCPWM Timer
    --2.MCPWM Capture{submodule that can work even without the above MCPWM
operators. The capture consists one dedicated timer and several independent
channels, with each channel connected to the GPIO. A pulse on the GPIO triggers
the capture timer to store the time-base count value and then notify you by an
interrupt. Using this feature, you can measure a pulse width precisely} : MCPWM
Capture Timer--MCPWM Capture Channel
    --3.MCPWM Operators{They key module that is responsibleb for generating the
PWM waveforms. It consists of other submodules, like comparator, PWM generator,
dead time, and carrier modulator}: MCPWM Comparators---MCPWM Generators---Dead
time---Carrier Modulation---Brake(this can be read from a FAULT GPIO pin on your
esp) goes outo.....
    --4.PWM Channels: PWM_A, PWM_B, etc....



[Resource Allocation and Initialization]
As displayed in the diagram above(sort of), the MCPWM peripheral consists of
several submodules. Each submodule has its own resource allocation... [MCPWM
Timers] You can allocate a MCPWM timer object by calling mcpwm_new_timer()


Now for ESC calibration this website recommends using this conventional standard
to aid in your PWM settings for the ESC [ESC/Throttle Mode] 1.Run ESC
calibration on your hardware first to determine its min/max pulse range 2.Enter
those calibrated values(typically 1000-2000us) and the control frequency
(typically 50Hz) 3.Set throttle percentage to verify the pulse width at each
operating point 4.Use Pulse width to verify against an oscillopscope or logic
analyzer during debugging
*/

/*
 * Tubi the Wizard Frog -- 4 hobby servos on one MCPWM timer (50 Hz)
 * Board: DOIT ESP32 DEVKIT V1 (ESP32-D0WD-V3)
 *
 *   servo      GPIO   job
 *   HEAD       5      bobs up at the start of every spoken word, down at the end
 *   ARM        18     up/down gesture
 *   LAZY SUSAN 21     positional servo, 4 bins
 *   TRAP DOOR  19     closed / open
 *   Share GND between the servo supply and the ESP32.
 *
 * One timer feeds two operators; each operator has two comparator/generator
 * pairs -> 4 independent pulse widths from one MCPWM group. All four servos
 * are slewed toward their targets in the same 20 ms loop, so they move at the
 * same time, each at its own speed.
 *
 * ---- Serial protocol (UART0, 115200, one command per line, '\n' ends it) ---
 * Works from the Pi AND from a plain serial monitor (pio device monitor).
 *
 *   Any mode:
 *     status                  print mode, state and every servo's angle/pulse
 *     test | run              switch mode (boots in RUN)
 *     bin <1-4>               lazy susan to bin 1..4          (alias: slot)
 *     door open | close       trap door
 *     head up | down          head to its calibrated pose
 *     arm  up | down          arm  to its calibrated pose
 *     talk <ms> <ms> ...      one entry per word: that word's duration in ms.
 *                             Head AND arm go up when each word starts and dip
 *                             back down before it ends. After the last word
 *                             both end in their rest (down) position. Runs by
 *                             itself -- no serial traffic between words, so no
 *                             timing jitter.
 *     dispense <1-4>          the final decision: lazy susan rotates to that
 *                             bin, then the trap door opens, stays open for
 *                             DOOR_HOLD_MS and closes. Runs by itself, at the
 *                             same time as a talk (separate servos). Replies
 *                             "OK dispense done" when finished.
 *     stop                    abort talk AND dispense; head/arm to rest, door closes
 *
 *   TEST mode only (find out how far each servo should go):
 *     head <deg>   arm <deg>   lazy <deg>   door <deg>
 *     deg is 0..180, clamped to that servo's safe limits (see servos[]).
 *     Type e.g. "head 105", look at the linkage, repeat. Then copy the numbers
 *     into the POSE_* constants below.
 *     Lazy susan: find the angle of each funnel (lazy 20, lazy 55, ...), copy
 *     them into POSE_BIN1..4_DEG, then check with "bin 1".."bin 4".
 *     Trap door:  find the closed and open angles, copy them into
 *     POSE_DOOR_CLOSED / POSE_DOOR_OPEN, then check with "door open|close".
 */

#include <stdarg.h>
#include <stdio.h>
#include <stdlib.h>
#include <string.h>
#include <ctype.h>
#include <stdbool.h>
#include "driver/mcpwm_prelude.h"
#include "driver/gpio.h"
#include "driver/uart.h"
#include "freertos/FreeRTOS.h"
#include "freertos/task.h"
#include "esp_log.h"
#include "pwm.h"

#define UART_NUM            UART_NUM_0
#define BUFFER_SIZE         512             /* UART rx ring = 2x this */
#define LINE_MAX_LEN        512

static const char *PWMTAG = "PWM";

#define PWM_RESOLUTION_HZ   1000000           /* 1 MHz -> 1 tick = 1 us */
#define PWM_PERIOD_TICKS    20000             /* 20000 us = 20 ms = 50 Hz */
#define CONTROL_PERIOD_MS   20                /* one update per PWM period */

/* ---- Calibrated poses (degrees) --------------------------------------- *
 * TUNE THESE in test mode. HEAD/ARM numbers are placeholders. The door and
 * lazy susan values are the old pulse widths converted at 500-2500 us = 0-180.
 */
#define POSE_HEAD_DOWN      150.0f            /* measured */
#define POSE_HEAD_UP        100.0f            /* measured */
#define POSE_ARM_DOWN       80.0f             /* measured: rest position */
#define POSE_ARM_UP         0.0f              /* measured: raised */
#define POSE_ARM_WORD_LOW   40.0f             /* arm dips to here between words, halfway down (TUNE) */
#define POSE_DOOR_CLOSED    117.0f            /* was 1800 us */
#define POSE_DOOR_OPEN      171.0f            /* was 2400 us */

#define NUM_BINS            4
#define POSE_BIN1_DEG       180.0f            /* was 2500 us */
#define POSE_BIN2_DEG       126.0f            /* was 1900 us */
#define POSE_BIN3_DEG       63.0f             /* was 1200 us */
#define POSE_BIN4_DEG       0.0f              /* was 400 us (below the 500 us clamp, so 0 deg) */
static const float POSE_BIN_DEG[NUM_BINS] = {
    POSE_BIN1_DEG, POSE_BIN2_DEG, POSE_BIN3_DEG, POSE_BIN4_DEG,
};

/* Dispense timing (ms). Servo "arrived" means the commanded position was
 * reached; real servos lag a little, so we wait a bit longer. */
#define LAZY_SETTLE_MS      300               /* after the lazy susan arrives, before the door opens */
#define DOOR_HOLD_MS        400               /* door stays open this long (snack drops) */
#define DOOR_SETTLE_MS      200               /* after the door closes, before reporting done */

/* While talking: head is up for this fraction of each word, then drops. */
#define TALK_UP_FRACTION    0.6f
#define TALK_MAX_WORDS      64

/* ---- Servo table ------------------------------------------------------ */

typedef enum { SERVO_HEAD, SERVO_ARM, SERVO_LAZY, SERVO_DOOR, SERVO_COUNT } servo_id_t;

typedef struct {
    const char *name;
    gpio_num_t gpio;
    uint32_t min_us, max_us;        /* pulse at 0 deg and at 180 deg */
    float min_deg, max_deg;         /* safe travel -- test-mode input is clamped to this */
    uint32_t step_us;               /* max pulse change per 20 ms tick (speed) */
    float home_deg;                 /* where it sits at boot */
    mcpwm_cmpr_handle_t cmpr;
    mcpwm_gen_handle_t gen;
    uint32_t current_us;
    uint32_t target_us;
} servo_t;

static servo_t servos[SERVO_COUNT] = {
    [SERVO_HEAD] = { .name = "head", .gpio = GPIO_NUM_5 , .min_us = 500, .max_us = 2500,
                     .min_deg = 60,  .max_deg = 150, .step_us = 100, .home_deg = POSE_HEAD_DOWN },
    [SERVO_ARM]  = { .name = "arm",  .gpio = GPIO_NUM_18, .min_us = 500, .max_us = 2500,
                     .min_deg = 0,   .max_deg = 180, .step_us = 120, .home_deg = POSE_ARM_DOWN },
    [SERVO_LAZY] = { .name = "lazy", .gpio = GPIO_NUM_21, .min_us = 500, .max_us = 2500,
                     .min_deg = 0,   .max_deg = 180, .step_us = 40,  .home_deg = POSE_BIN1_DEG },
    [SERVO_DOOR] = { .name = "door", .gpio = GPIO_NUM_19, .min_us = 500, .max_us = 2500,
                     .min_deg = 0,   .max_deg = 180, .step_us = 60,  .home_deg = POSE_DOOR_CLOSED },
};

static uint32_t deg_to_us(const servo_t *s, float deg)
{
    return s->min_us + (uint32_t)((deg / 180.0f) * (float)(s->max_us - s->min_us) + 0.5f);
}

static float us_to_deg(const servo_t *s, uint32_t us)
{
    return ((float)us - (float)s->min_us) * 180.0f / (float)(s->max_us - s->min_us);
}

/* Set a new target angle (clamped to the servo's safe range). Returns the
 * angle actually used. The 20 ms loop slews the servo there. */
static float servo_set_angle(servo_id_t id, float deg)
{
    servo_t *s = &servos[id];
    if (deg < s->min_deg) deg = s->min_deg;
    if (deg > s->max_deg) deg = s->max_deg;
    s->target_us = deg_to_us(s, deg);
    return deg;
}

/* Move ONE slew step toward the target, called once per control period. */
static void servo_tick(servo_t *s)
{
    if (s->current_us == s->target_us) {
        return;
    }
    uint32_t next;
    if (s->current_us < s->target_us) {
        next = (s->target_us - s->current_us < s->step_us) ? s->target_us
                                                          : s->current_us + s->step_us;
    } else {
        next = (s->current_us - s->target_us < s->step_us) ? s->target_us
                                                          : s->current_us - s->step_us;
    }
    s->current_us = next;
    ESP_ERROR_CHECK(mcpwm_comparator_set_compare_value(s->cmpr, next));
}

/* ---- The four movement functions -------------------------------------- */

/* 1. head: any angle 0..180 (clamped). */
void move_head(float deg)            { servo_set_angle(SERVO_HEAD, deg); }

/* 2. arm: any angle 0..180 (clamped). */
void move_arm(float deg)             { servo_set_angle(SERVO_ARM, deg); }

/* 3. lazy susan: bin 1..4. Returns false for a bad bin number. */
bool move_lazy_susan(int bin)
{
    if (bin < 1 || bin > NUM_BINS) return false;
    servo_set_angle(SERVO_LAZY, POSE_BIN_DEG[bin - 1]);
    return true;
}

/* 4. trap door. */
void move_trap_door(bool open)       { servo_set_angle(SERVO_DOOR, open ? POSE_DOOR_OPEN : POSE_DOOR_CLOSED); }

/* ---- MCPWM setup ------------------------------------------------------ */

static mcpwm_timer_handle_t timer = NULL;
static mcpwm_oper_handle_t opers[2] = { NULL, NULL };

void pwm_init(void)
{
    mcpwm_timer_config_t timer_config = {
        .group_id      = 0,
        .clk_src       = MCPWM_TIMER_CLK_SRC_DEFAULT,
        .resolution_hz = PWM_RESOLUTION_HZ,
        .count_mode    = MCPWM_TIMER_COUNT_MODE_UP,
        .period_ticks  = PWM_PERIOD_TICKS,
        .intr_priority = 0,
    };
    ESP_ERROR_CHECK(mcpwm_new_timer(&timer_config, &timer));

    /* An operator has 2 comparators + 2 generators, so 2 operators = 4 servos. */
    mcpwm_operator_config_t oper_config = { .group_id = 0, .intr_priority = 0 };
    for (int i = 0; i < 2; i++) {
        ESP_ERROR_CHECK(mcpwm_new_operator(&oper_config, &opers[i]));
        ESP_ERROR_CHECK(mcpwm_operator_connect_timer(opers[i], timer));
    }

    for (int i = 0; i < SERVO_COUNT; i++) {
        servo_t *s = &servos[i];
        mcpwm_oper_handle_t oper = opers[i / 2];

        /* New compare values latch at the start of a period (no glitched pulses). */
        mcpwm_comparator_config_t cmpr_config = { .intr_priority = 0, .flags.update_cmp_on_tez = true };
        ESP_ERROR_CHECK(mcpwm_new_comparator(oper, &cmpr_config, &s->cmpr));

        s->current_us = deg_to_us(s, s->home_deg);
        s->target_us  = s->current_us;
        ESP_ERROR_CHECK(mcpwm_comparator_set_compare_value(s->cmpr, s->current_us));

        mcpwm_generator_config_t gen_config = { .gen_gpio_num = s->gpio };
        ESP_ERROR_CHECK(mcpwm_new_generator(oper, &gen_config, &s->gen));

        /* Period starts (timer empty): HIGH. Timer hits the compare value: LOW. */
        ESP_ERROR_CHECK(mcpwm_generator_set_action_on_timer_event(
            s->gen,
            MCPWM_GEN_TIMER_EVENT_ACTION(MCPWM_TIMER_DIRECTION_UP,
                                         MCPWM_TIMER_EVENT_EMPTY,
                                         MCPWM_GEN_ACTION_HIGH)));
        ESP_ERROR_CHECK(mcpwm_generator_set_action_on_compare_event(
            s->gen,
            MCPWM_GEN_COMPARE_EVENT_ACTION(MCPWM_TIMER_DIRECTION_UP,
                                           s->cmpr,
                                           MCPWM_GEN_ACTION_LOW)));
        ESP_LOGI(PWMTAG, "%s on GPIO %d, home %.0f deg (%u us)",
                 s->name, s->gpio, s->home_deg, (unsigned)s->current_us);
    }

    ESP_ERROR_CHECK(mcpwm_timer_enable(timer));
    ESP_ERROR_CHECK(mcpwm_timer_start_stop(timer, MCPWM_TIMER_START_NO_STOP));
}

/* ---- State machine ---------------------------------------------------- *
 *
 *   mode:   MODE_RUN  (default) -- what the Pi drives
 *           MODE_TEST           -- adds raw per-servo angle commands
 *   Two independent state machines run in the same 20 ms loop, so head/arm
 *   and lazy susan/door can move at the same time:
 *
 *   talk:      TALK_IDLE -> TALK_ACTIVE -> TALK_IDLE
 *     per word: [word starts] head UP, arm UP --(TALK_UP_FRACTION)--> head
 *     DOWN, arm dips --(rest of word)--> next word starts. After the last
 *     word: head and arm to rest.
 *
 *   dispense:  DSP_IDLE -> DSP_ROTATING -> DSP_OPENING -> DSP_CLOSING -> DSP_IDLE
 *     ROTATING: door closed, lazy susan moves to the bin; wait until it has
 *               arrived + LAZY_SETTLE_MS.
 *     OPENING:  door opens; wait until open + DOOR_HOLD_MS.
 *     CLOSING:  door closes; wait until closed + DOOR_SETTLE_MS, then done.
 *
 *   `stop` aborts both.
 */

typedef enum { MODE_RUN, MODE_TEST } mode_t_;
typedef enum { TALK_IDLE, TALK_ACTIVE } talk_state_t;
typedef enum { DSP_IDLE, DSP_ROTATING, DSP_OPENING, DSP_CLOSING } dispense_state_t;

static mode_t_          mode        = MODE_RUN;
static talk_state_t     talk_state  = TALK_IDLE;
static dispense_state_t dsp_state   = DSP_IDLE;
static int32_t          dsp_arrived_ms = -1;   /* when the current step's servo reached its target */

static uint32_t talk_ms[TALK_MAX_WORDS];
static int      talk_count = 0;
static int      talk_idx = 0;
static bool     talk_head_up = false;
static int32_t  talk_next_event_ms = 0;     /* tick time of the next up/down flip */

static int32_t now_ms(void)
{
    return (int32_t)(xTaskGetTickCount() * portTICK_PERIOD_MS);
}

static void reply(const char *fmt, ...)
{
    char buf[160];
    va_list ap;
    va_start(ap, fmt);
    int n = vsnprintf(buf, sizeof(buf) - 2, fmt, ap);
    va_end(ap);
    if (n < 0) return;
    if (n > (int)sizeof(buf) - 3) n = sizeof(buf) - 3;
    buf[n++] = '\n';
    uart_write_bytes(UART_NUM, buf, n);
}

/* End of a sentence (or `stop`): head and arm to rest. */
static void talk_finish(void)
{
    talk_state = TALK_IDLE;
    talk_head_up = false;
    move_head(POSE_HEAD_DOWN);
    move_arm(POSE_ARM_DOWN);
}

static void talk_begin_word(void)
{
    move_head(POSE_HEAD_UP);
    move_arm(POSE_ARM_UP);
    talk_head_up = true;
    talk_next_event_ms = now_ms() + (int32_t)(talk_ms[talk_idx] * TALK_UP_FRACTION);
}

static void talk_start(void)
{
    talk_state = TALK_ACTIVE;
    talk_idx = 0;
    talk_begin_word();
}

static void talk_tick(void)
{
    if (talk_state != TALK_ACTIVE) return;
    if ((int32_t)(now_ms() - talk_next_event_ms) < 0) return;

    if (talk_head_up) {
        /* Head drops at the end of the word; next word starts after the remainder. */
        move_head(POSE_HEAD_DOWN);
        /* Every word dips the arm; the last word goes straight to rest. */
        move_arm(talk_idx < talk_count - 1 ? POSE_ARM_WORD_LOW : POSE_ARM_DOWN);
        talk_head_up = false;
        talk_next_event_ms += (int32_t)(talk_ms[talk_idx] * (1.0f - TALK_UP_FRACTION));
    } else {
        talk_idx++;
        if (talk_idx >= talk_count) {
            talk_finish();
            reply("OK talk done");
        } else {
            talk_begin_word();
        }
    }
}

/* ---- Dispense state machine ------------------------------------------- */

static bool servo_at_target(servo_id_t id)
{
    return servos[id].current_us == servos[id].target_us;
}

/* True once the servo has been at its target for settle_ms. */
static bool servo_settled(servo_id_t id, uint32_t settle_ms)
{
    if (!servo_at_target(id)) {
        dsp_arrived_ms = -1;
        return false;
    }
    if (dsp_arrived_ms < 0) dsp_arrived_ms = now_ms();
    return (int32_t)(now_ms() - dsp_arrived_ms) >= (int32_t)settle_ms;
}

static void dispense_enter(dispense_state_t next)
{
    dsp_state = next;
    dsp_arrived_ms = -1;
    switch (next) {
    case DSP_OPENING: move_trap_door(true);  break;
    case DSP_CLOSING: move_trap_door(false); break;
    default: break;
    }
}

static void dispense_start(int bin)
{
    move_trap_door(false);          /* make sure it is shut while the tray turns */
    move_lazy_susan(bin);
    dispense_enter(DSP_ROTATING);
    dsp_arrived_ms = -1;
}

static void dispense_abort(void)
{
    dsp_state = DSP_IDLE;
    move_trap_door(false);
    servos[SERVO_LAZY].target_us = servos[SERVO_LAZY].current_us;   /* halt the tray where it is */
}

static void dispense_tick(void)
{
    switch (dsp_state) {
    case DSP_IDLE:
        break;
    case DSP_ROTATING:
        if (servo_settled(SERVO_LAZY, LAZY_SETTLE_MS)) dispense_enter(DSP_OPENING);
        break;
    case DSP_OPENING:
        if (servo_settled(SERVO_DOOR, DOOR_HOLD_MS)) dispense_enter(DSP_CLOSING);
        break;
    case DSP_CLOSING:
        if (servo_settled(SERVO_DOOR, DOOR_SETTLE_MS)) {
            dsp_state = DSP_IDLE;
            reply("OK dispense done");
        }
        break;
    }
}

/* ---- Command parser --------------------------------------------------- */

static bool parse_float(const char *tok, float *out)
{
    if (!tok) return false;
    char *end;
    float v = strtof(tok, &end);
    if (end == tok || *end != '\0') return false;
    *out = v;
    return true;
}

static void cmd_status(void)
{
    reply("mode=%s talk=%s dispense=%s", mode == MODE_TEST ? "test" : "run",
          talk_state == TALK_ACTIVE ? "active" : "idle",
          dsp_state == DSP_IDLE ? "idle" : dsp_state == DSP_ROTATING ? "rotating"
                                : dsp_state == DSP_OPENING ? "opening" : "closing");
    for (int i = 0; i < SERVO_COUNT; i++) {
        reply("  %-4s %6.1f deg  %4u us (target %4u us)  limits %.0f-%.0f deg",
              servos[i].name, us_to_deg(&servos[i], servos[i].current_us),
              (unsigned)servos[i].current_us, (unsigned)servos[i].target_us,
              servos[i].min_deg, servos[i].max_deg);
    }
}

/* head/arm/lazy/door: a keyword anywhere, a raw angle only in test mode. */
static void cmd_servo(servo_id_t id, const char *arg)
{
    if (!arg) { reply("ERR %s needs an argument", servos[id].name); return; }

    if (id == SERVO_HEAD && !strcmp(arg, "up"))    { move_head(POSE_HEAD_UP);   reply("OK head up"); return; }
    if (id == SERVO_HEAD && !strcmp(arg, "down"))  { move_head(POSE_HEAD_DOWN); reply("OK head down"); return; }
    if (id == SERVO_ARM  && !strcmp(arg, "up"))    { move_arm(POSE_ARM_UP);     reply("OK arm up"); return; }
    if (id == SERVO_ARM  && !strcmp(arg, "down"))  { move_arm(POSE_ARM_DOWN);   reply("OK arm down"); return; }
    if (id == SERVO_DOOR && !strcmp(arg, "open"))  { move_trap_door(true);      reply("OK door open"); return; }
    if (id == SERVO_DOOR && !strcmp(arg, "close")) { move_trap_door(false);     reply("OK door close"); return; }

    float deg;
    if (!parse_float(arg, &deg)) { reply("ERR bad argument '%s'", arg); return; }
    if (mode != MODE_TEST)       { reply("ERR raw angles need test mode (send 'test')"); return; }
    float used = servo_set_angle(id, deg);
    if (used != deg) reply("OK %s -> %.1f deg (clamped from %.1f)", servos[id].name, used, deg);
    else             reply("OK %s -> %.1f deg", servos[id].name, used);
}

static void handle_line(char *line)
{
    for (char *p = line; *p; p++) *p = (char)tolower((unsigned char)*p);

    char *save = NULL;
    char *cmd = strtok_r(line, " \t", &save);
    if (!cmd) return;

    if (!strcmp(cmd, "status")) { cmd_status(); return; }

    if (!strcmp(cmd, "test")) { mode = MODE_TEST; reply("OK mode=test"); return; }
    if (!strcmp(cmd, "run"))  { mode = MODE_RUN;  reply("OK mode=run");  return; }

    if (!strcmp(cmd, "stop")) { talk_finish(); dispense_abort(); reply("OK stopped"); return; }

    if (!strcmp(cmd, "dispense")) {
        char *arg = strtok_r(NULL, " \t", &save);
        int bin = arg ? atoi(arg) : 0;
        if (bin < 1 || bin > NUM_BINS)  { reply("ERR dispense needs a bin 1..%d", NUM_BINS); return; }
        if (dsp_state != DSP_IDLE)      { reply("ERR dispense busy"); return; }
        dispense_start(bin);
        reply("OK dispense bin %d", bin);
        return;
    }

    if (!strcmp(cmd, "bin") || !strcmp(cmd, "slot")) {
        char *arg = strtok_r(NULL, " \t", &save);
        int bin = arg ? atoi(arg) : 0;
        if (move_lazy_susan(bin)) reply("OK bin %d", bin);
        else                      reply("ERR bin must be 1..%d", NUM_BINS);
        return;
    }

    if (!strcmp(cmd, "talk")) {
        int n = 0;
        char *tok;
        while (n < TALK_MAX_WORDS && (tok = strtok_r(NULL, " \t", &save)) != NULL) {
            float ms;
            if (!parse_float(tok, &ms) || ms < 50 || ms > 5000) { reply("ERR bad word duration '%s'", tok); return; }
            talk_ms[n++] = (uint32_t)ms;
        }
        if (n == 0) { reply("ERR talk needs word durations in ms"); return; }
        talk_count = n;
        talk_start();
        reply("OK talk %d words", n);
        return;
    }

    char *arg = strtok_r(NULL, " \t", &save);
    if (!strcmp(cmd, "head")) { cmd_servo(SERVO_HEAD, arg); return; }
    if (!strcmp(cmd, "arm"))  { cmd_servo(SERVO_ARM, arg);  return; }
    if (!strcmp(cmd, "lazy")) { cmd_servo(SERVO_LAZY, arg); return; }
    if (!strcmp(cmd, "door")) { cmd_servo(SERVO_DOOR, arg); return; }

    reply("ERR unknown command '%s'", cmd);
}

/* ---- Main ------------------------------------------------------------- */

void app_main(void)
{
    pwm_init();
    uart_driver_install(UART_NUM, BUFFER_SIZE * 2, 0, 0, NULL, 0);

    static char line[LINE_MAX_LEN];
    size_t len = 0;
    bool overflow = false;
    uint8_t chunk[64];

    reply("Tubi ready (mode=run). Commands: status test run bin head arm door talk dispense stop");

    while (1) {
        /* Waits up to one control period for input, which also paces the loop. */
        int got = uart_read_bytes(UART_NUM, chunk, sizeof(chunk), pdMS_TO_TICKS(CONTROL_PERIOD_MS));
        for (int i = 0; i < got; i++) {
            char c = (char)chunk[i];
            if (c == '\n' || c == '\r') {
                if (overflow)      reply("ERR line too long");
                else if (len > 0) { line[len] = '\0'; handle_line(line); }
                len = 0;
                overflow = false;
            } else if (len < LINE_MAX_LEN - 1) {
                line[len++] = c;
            } else {
                overflow = true;
            }
        }

        talk_tick();
        dispense_tick();
        for (int i = 0; i < SERVO_COUNT; i++) {
            servo_tick(&servos[i]);
        }
    }
}
