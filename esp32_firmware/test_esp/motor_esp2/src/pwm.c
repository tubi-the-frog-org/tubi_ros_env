/*
okay let's see if we can understand the using the api espressif provides via
their website recall that the esp chip itself is the ESP32-D0WD-V3 and on the
DOIT ESP32 DEVKIT V1 board


    *   *   *   *   *   *   *   *   *   *   *   *   *   *   *   *   *   *   * *
*   *   * Motor Control Pulse Width Modulator(MCPWM)
    *   *   *   *   *   *   *   *   *   *   *   *   *   *   *   *   *   *   * *
*   *   * The MCPWM peripheral is a versatile PWM generator, which contains
various submodules to make it a key element in power electronic applications
like motor control, digital power, and so on... iT CAN provide six PWM outputs
that can be set up to operate in several topologies. One common topology uses a
pair of PWM outputs driving a H-bridge to control motor rotation speed and
rotation direction. The timing and control resources inside are allocated into
two major types of submodules -PWM Timers and PWM Operators Each PWM timer
provides timing references that can either run freely or be synced to other
timers or external sources. Each PWM operator has all necessary control
resources to generate waveform pairs for one PWM channel. The MCPWM peripheral
also contains a dedicated capture submodule that is used in systems where
accurate timing of external events is important ESP32 contains two MCPWM
peripherals: MCPWM0 & MCPWM1. Their control registers are located in 4kB memory
blocks starting at memory locations 0x3FF5E000 and 0x3FF6C000 respectively

[Overview]
    --PWM Timers 0,1 and 2
    --Every PWM timer has a dedicated 8-bit clock prescaler
    --The 16-bit counter in the PWM timer can work in count-up mode, count-down
mode or count-up-down mode
    --A hardware sync can trigger a reload on the PWM timer with a phase
register. It will also trigger the prescaler's restart, so that the timer's
clock can also be synced. The source of the sync can come from any GPIO or any
    other PWM timer's sync_out

    --PWM Operators 0, 1 and 2
    --Every PWM operator has two PWM outputs: PWMxA and PWMxB. They can work
independently, in symmetric and asymmetric configuration
    --Software, asychronous override control of PWM signals
    --Configurable dead-time on rising and falling edges; each setup
independetly
    --All events can trigger CPU interrupts
    --Modulating of PWM output by high-frequency carrier signals, useful when
gate drives are insulated with a transformer.
    --Period, time stamps and important control register have shadow registers
with flexible updating methods


    --Fault Detection Module
    --Programmable fault handling allocated on fault condition in both
cycle-by-cycle mode and one-shot mode
    --A fault condition can force the PWM output to either high or low logic
levels

    --Capture module
    --Speed measurement of rotating machinery
    --Measurement of elapsed time between position sensor pulses
    --Period and duty-cycle measurement of pulse train signals
    --Decoding current or voltage amplitude derived from duty-cycle encoded
signals from current/voltage sensors
    --Three individual capture channels, each of which has a time-stamp register
32 bits
    --Selection of edge polarity and prescaling of input capture signal
    --The capture timer can sync with a PWM timer or external signals
    --Interrupt on each of the three capture channels



[Features]
Each MCPWM peripheral has one clock divider(prescaler), three PWM timers, three
PWM operators, and a capture module. PWM timers are used for generating timing
references to produce related PWM signals. PWM operators can also use different
PWM timer values to produce the PWM signals that work alone. Different PWM
operators can also use different PWM timer values to produce the PWM signals
that work alone. Different PWM timers can also be synced together.


Typically, the MCPWM peripheral can be used in the following scenarios...
    ---Digital motor control, e.g brushed/brushless DC motor, RC servo motor
    ---Switch mode-based digital power conversion
    ---Power DAC, where the duty cycle is eq. to a DAC analog value
    ---Calculate external pulse width, and convert it into other analog values
like speed, distance
    ---Generate Space Vector PWM (SVPWM) signals for Field Oriented Control
(FOC)

The main submodules being the
    --1.MCPWM SYnc{module focused on synchronizing the MCPWM timers, so that the
final PWM signals generated by different MCPWM generators can have a fixed phase
difference}  : Sync GPIO---Timer Sync goes into.....MCPWM Timer
    --2.MCPWM Capture{submodule that can work even without the above MCPWM
operators. The capture consists one dedicated timer and several independent
channels, with each channel connected to the GPIO. A pulse on the GPIO triggers
the capture timer to store the time-base count value and then notify you by an
interrupt. Using this feature, you can measure a pulse width precisely} : MCPWM
Capture Timer--MCPWM Capture Channel
    --3.MCPWM Operators{They key module that is responsibleb for generating the
PWM waveforms. It consists of other submodules, like comparator, PWM generator,
dead time, and carrier modulator}: MCPWM Comparators---MCPWM Generators---Dead
time---Carrier Modulation---Brake(this can be read from a FAULT GPIO pin on your
esp) goes outo.....
    --4.PWM Channels: PWM_A, PWM_B, etc....



[Resource Allocation and Initialization]
As displayed in the diagram above(sort of), the MCPWM peripheral consists of
several submodules. Each submodule has its own resource allocation... [MCPWM
Timers] You can allocate a MCPWM timer object by calling mcpwm_new_timer()


Now for ESC calibration this website recommends using this conventional standard
to aid in your PWM settings for the ESC [ESC/Throttle Mode] 1.Run ESC
calibration on your hardware first to determine its min/max pulse range 2.Enter
those calibrated values(typically 1000-2000us) and the control frequency
(typically 50Hz) 3.Set throttle percentage to verify the pulse width at each
operating point 4.Use Pulse width to verify against an oscillopscope or logic
analyzer during debugging
*/
/*
 * ESP32 potentiometer -> ESC throttle via MCPWM (50 Hz, 1000-2000 us)
 * Board: DOIT ESP32 DEVKIT V1 (ESP32-D0WD-V3)
 *
 * Wiring:
 *   Pot wiper -> GPIO36 (VP)   [ADC1_CHANNEL_0, input-only pin]
 *   ESC signal -> GPIO18
 *   Share GND between the ESC, the pot and the ESP32
 *
 * Needs `esp_adc` in the REQUIRES list of src/CMakeLists.txt:
 *   REQUIRES driver esp_adc log freertos
 

 
 */


#include <stdio.h>
#include "driver/mcpwm_prelude.h"
#include "driver/gpio.h"
#include "freertos/FreeRTOS.h"
#include "freertos/task.h"
#include "driver/uart.h"
#include "esp_log.h"
#include "adc.h"
#include "pwm.h"
#include "driver/dac_continuous.h"
#include "driver/dac_types.h"
#include "freertos/queue.h"
#include "freertos/stream_buffer.h"
#define UART_NUM UART_NUM_0
#define BUFFER_SIZE 128
static const char *uart_tag = "UART";
static const char *dac_tag = "DAC";
/* ---- Main ------------------------------------------------------------- */



static const char *PWMTAG = "PWM";

#define PWM_GPIO            GPIO_NUM_18       /* check against the DEVKIT V1 pinout */
#define PWM_GROUP_ID        0                 /* timer and operator must share a group */
#define PWM_RESOLUTION_HZ   1000000           /* 1 MHz -> 1 tick = 1 us */
#define PWM_PERIOD_TICKS    20000             /* 20000 us = 20 ms = 50 Hz */


//DIRECTIONAL MOVEMENT FOR LAZY SUZAN TABLE!!!!
#define LAZY_POS_4  400
#define LAZY_POS_3   1200              /* full reverse (bidirectional ESC) */
#define LAZY_POS_2 1900              /* neutral / stopped */
#define LAZY_POS_1    2500              /* full forward */

//DIRECTIONAL MOVEMENT FOR SERVO TRAP DOOR!!!!
#define TRAP_DOOR_CLOSE 1800 //starting the position
#define TRAP_DOOR_OPEN  2400 //opening position??


//slew rate control of servo/motor
#define ESC_ARM_TIME_MS     2000              /* hold neutral at boot so the ESC arms */
#define CONTROL_PERIOD_MS   20                /* one update per PWM period */
#define RAMP_STEP_US        12                 /* 5 us / 20 ms -> 1000 us takes ~4 s */

//DAC parameters for AUDIO
#define DAC_FREQ_HZ   22050
#define DAC_DESC_NUM  4
#define DAC_BUF_SIZE  2048




static uint32_t current_us = LAZY_POS_1;   /* last commanded pulse */

/* Turn a raw pot reading into a target pulse width. Swap this function out
 * to change how the pot behaves (see the proportional version in the chat). */
// static uint32_t target_from_adc(int raw)
// {
//     if (raw < ADC_LOW_THRESHOLD)  return ESC_MIN_PULSE_US;
//     if (raw > ADC_HIGH_THRESHOLD) return ESC_MAX_PULSE_US;
//     return ESC_MIDDLE_PULSE_US;
// }

/* ---- ESC helpers ------------------------------------------------------ */

static uint32_t esc_clamp_us(uint32_t us)
{
    if (us < 500) return 500;
    if (us > 2500) return 2500;
    return us;
}

/* Set the pulse width immediately (clamped). Ticks == microseconds at 1 MHz. */
static esp_err_t esc_set_pulse_us(mcpwm_cmpr_handle_t comparator, uint32_t pulse_us)
{
    pulse_us = esc_clamp_us(pulse_us);
    current_us = pulse_us;
    return mcpwm_comparator_set_compare_value(comparator, pulse_us);
}










/* Move ONE slew step toward the target. Non-blocking: call once per control
 * period so the caller can keep reading inputs while the output ramps. */
static void esc_step_toward(mcpwm_cmpr_handle_t comparator, uint32_t target_us)
{
    target_us = esc_clamp_us(target_us);
    if (current_us == target_us) {
        return;
    }

    uint32_t next;
    if (current_us < target_us) {
        next = (target_us - current_us < RAMP_STEP_US) ? target_us
                                                       : current_us + RAMP_STEP_US;
    } else {
        next = (current_us - target_us < RAMP_STEP_US) ? target_us
                                                       : current_us - RAMP_STEP_US;
    }
    ESP_ERROR_CHECK(esc_set_pulse_us(comparator, next));
}

//place the handles here....
mcpwm_timer_handle_t timer = NULL;
mcpwm_oper_handle_t oper = NULL;
mcpwm_cmpr_handle_t comparator = NULL;
mcpwm_gen_handle_t generator = NULL;
static dac_continuous_handle_t asynch_continous = NULL;
static QueueHandle_t dac_evt_queue = NULL;
StreamBufferHandle_t pcm_stream = NULL;   // decoder writes 8-bit unsigned PCM here....will need to explain this more!!

// ISR: runs when the DMA finishes one buffer. Just forward the event.
static bool IRAM_ATTR dac_on_convert_done(dac_continuous_handle_t handle,
                                          const dac_event_data_t *event,
                                          void *user_data)
{
    QueueHandle_t q = (QueueHandle_t)user_data;
    BaseType_t woken = pdFALSE;
    if (xQueueIsQueueFullFromISR(q)) {          // drop oldest if we fell behind
        dac_event_data_t dummy;
        xQueueReceiveFromISR(q, &dummy, &woken);
    }
    xQueueSendFromISR(q, event, &woken);
    return woken == pdTRUE;
}

// Task: refill each finished buffer with PCM (or silence)
static void dac_feed_task(void *arg)
{
    static uint8_t stage[DAC_BUF_SIZE];
    dac_event_data_t evt;
    while (1) {
        xQueueReceive(dac_evt_queue, &evt, portMAX_DELAY);

        size_t got = xStreamBufferReceive(pcm_stream, stage, evt.buf_size, 0);
        if (got < evt.buf_size) {
            memset(stage + got, 128, evt.buf_size - got);   // 128 = mid-scale silence
        }

        size_t loaded = 0;
        dac_continuous_write_asynchronously(asynch_continous, evt.buf, evt.buf_size,
                                            stage, evt.buf_size, &loaded);
    }
}

void dac_init(void)
{
    dac_continuous_config_t cfg = {
        .chan_mask = DAC_CHANNEL_MASK_CH0,       // GPIO25
        .desc_num  = DAC_DESC_NUM,
        .buf_size  = DAC_BUF_SIZE,
        .freq_hz   = DAC_FREQ_HZ,
        .offset    = 0,
        .clk_src   = DAC_DIGI_CLK_SRC_DEFAULT,
        .chan_mode = DAC_CHANNEL_MODE_SIMUL,
    };
    ESP_ERROR_CHECK(dac_continuous_new_channels(&cfg, &asynch_continous));

    dac_evt_queue = xQueueCreate(DAC_DESC_NUM, sizeof(dac_event_data_t));
    pcm_stream    = xStreamBufferCreate(16 * 1024, 1);

    dac_event_callbacks_t cbs = {
        .on_convert_done = dac_on_convert_done,
        .on_stop = NULL,
    };
    ESP_ERROR_CHECK(dac_continuous_register_event_callback(asynch_continous, &cbs, dac_evt_queue));

    ESP_ERROR_CHECK(dac_continuous_enable(asynch_continous));
    ESP_ERROR_CHECK(dac_continuous_start_async_writing(asynch_continous));

    xTaskCreate(dac_feed_task, "dac_feed", 4096, NULL, 6, NULL);
    ESP_LOGI(dac_tag, "DAC running at %d Hz", DAC_FREQ_HZ);
}
void pwm_init(void){
        /* 1. Timer: default clock source is the 160 MHz PLL, divided down to 1 MHz */
    mcpwm_timer_config_t timer_config = {
        .group_id      = 0,
        .clk_src       = MCPWM_TIMER_CLK_SRC_DEFAULT,
        .resolution_hz = 1000000,
        .count_mode    = MCPWM_TIMER_COUNT_MODE_UP,
        .period_ticks  = 20000,
        .intr_priority = 0,
    };
    ESP_ERROR_CHECK(mcpwm_new_timer(&timer_config, &timer));
    ESP_LOGI(PWMTAG, "Timer created");

    /* 2. Operator: same group as the timer, then connected to it */
    mcpwm_operator_config_t oper_config = {
        .group_id      = 0,
        .intr_priority = 0,
    };
    ESP_ERROR_CHECK(mcpwm_new_operator(&oper_config, &oper));
    ESP_ERROR_CHECK(mcpwm_operator_connect_timer(oper, timer));
    ESP_LOGI(PWMTAG, "Operator created and connected to timer");

    /* 3. Comparator: sets the pulse width. New values latch when the timer
     * is empty (start of a period) so changes can't glitch a pulse. */
    mcpwm_comparator_config_t cmpr_config = {
        .intr_priority = 0,
        .flags.update_cmp_on_tez = true,
    };
    ESP_ERROR_CHECK(mcpwm_new_comparator(oper, &cmpr_config, &comparator));
    ESP_ERROR_CHECK(esc_set_pulse_us(comparator, LAZY_POS_1));//setting the default us
    ESP_LOGI(PWMTAG, "Comparator created, pulse = %d us", LAZY_POS_1);

    /* 4. Generator: drives the GPIO */
    mcpwm_generator_config_t gen_config = {
        .gen_gpio_num = GPIO_NUM_18,
    };
    ESP_ERROR_CHECK(mcpwm_new_generator(oper, &gen_config, &generator));

    /* Period starts (timer empty): output HIGH */
    ESP_ERROR_CHECK(mcpwm_generator_set_action_on_timer_event(
        generator,
        MCPWM_GEN_TIMER_EVENT_ACTION(MCPWM_TIMER_DIRECTION_UP,
                                     MCPWM_TIMER_EVENT_EMPTY,
                                     MCPWM_GEN_ACTION_HIGH)));

    /* Timer reaches the compare value: output LOW */
    ESP_ERROR_CHECK(mcpwm_generator_set_action_on_compare_event(
        generator,
        MCPWM_GEN_COMPARE_EVENT_ACTION(MCPWM_TIMER_DIRECTION_UP,
                                       comparator,
                                       MCPWM_GEN_ACTION_LOW)));
    ESP_LOGI(PWMTAG, "Generator created on GPIO %d", GPIO_NUM_18);

    /* 5. Start the timer; hardware now runs the waveform on its own */
    ESP_ERROR_CHECK(mcpwm_timer_enable(timer));
    ESP_ERROR_CHECK(mcpwm_timer_start_stop(timer, MCPWM_TIMER_START_NO_STOP));
    // ESP_LOGI(PWMTAG, "PWM running: 50 Hz, %d us pulse", ESC_MIDDLE_PULSE_US);

    // /* Hold neutral so the ESC can arm before any throttle is requested */
    // ESP_LOGI(PWMTAG, "Arming ESC (%d ms at neutral)...", ESC_ARM_TIME_MS);
    vTaskDelay(pdMS_TO_TICKS(ESC_ARM_TIME_MS));

}


uint32_t target_us = TRAP_DOOR_CLOSE;
uint8_t ch;

void app_main(void){
pwm_init();
dac_init();
uart_driver_install(UART_NUM, BUFFER_SIZE * 2, 0, 0, NULL, 0);
    while (1) {
    if (uart_read_bytes(UART_NUM, &ch, 1, pdMS_TO_TICKS(CONTROL_PERIOD_MS)) > 0) {
        switch (ch) {
        case '2': target_us = TRAP_DOOR_OPEN; break;
//        case '3': target_us = LAZY_POS_3;    break;
        case '1': target_us = TRAP_DOOR_CLOSE;    break;
//        case '4': target_us = LAZY_POS_4;   break;
        default: break;
        }
    }
    esc_step_toward(comparator, target_us);   /* one slew step per loop */
}
}
